AUTOSAR XML
3 x :
  INER UUID=
  INER UUID=
  INER UUID=
